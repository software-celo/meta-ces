## conf/bblayers.conf.sample
```bitbake
# POKY_BBLAYERS_CONF_VERSION is increased each time build/conf/bblayers.conf
# changes incompatibly
POKY_BBLAYERS_CONF_VERSION = "3"

BBPATH = "${TOPDIR}"
BBFILES ?= ""

BBLAYERS_DIR = "${@os.path.abspath(os.path.join("${TOPDIR}", os.pardir))}/sources"

YOCTO_LAYERS = " \
  ${BBLAYERS_DIR}/poky/meta \
  ${BBLAYERS_DIR}/poky/meta-poky \
  "

CES_CORE_LAYERS = " \
  ${BBLAYERS_DIR}/meta-openembedded/meta-oe \
  ${BBLAYERS_DIR}/meta-openembedded/meta-filesystems \
  ${BBLAYERS_DIR}/meta-openembedded/meta-multimedia \
  ${BBLAYERS_DIR}/meta-openembedded/meta-networking \
  ${BBLAYERS_DIR}/meta-openembedded/meta-python \
  ${BBLAYERS_DIR}/meta-python2 \
  ${BBLAYERS_DIR}/meta-virtualization \
  ${BBLAYERS_DIR}/meta-security/meta-tpm \
  "

CES_RAUC_LAYERS = " \
  ${BBLAYERS_DIR}/meta-rauc \
  "

CES_LAYERS = " \
  ${BBLAYERS_DIR}/meta-ces \
  "

CES_QT5_LAYERS = " \
  ${BBLAYERS_DIR}/meta-qt5 \
  "

CES_HW_LAYERS = " \
  ${BBLAYERS_DIR}/meta-freescale \
  "

BBLAYERS ?= " \
  ${YOCTO_LAYERS} \
  ${CES_CORE_LAYERS} \
  ${CES_HW_LAYERS} \
  ${CES_QT5_LAYERS} \
  ${CES_RAUC_LAYERS} \
  ${CES_LAYERS} \
  "

BBLAYERS_NON_REMOVABLE ?= " \
  ${YOCTO_LAYERS} \
  ${CES_LAYERS} \
  "

# bbappend to mesa from Freescale layer is harmful, because enabled features
# 'imxgpu' and 'imxgpu3d' filter out wanted "egl gbm gles" from PACKAGECONFIG.
# In addition after backporting fixes to mesa-19 the enabled vc4 driver is
# not needed anymore.
BBMASK_ces-fb += "${BBLAYERS_DIR}/meta-freescale/recipes-graphics/mesa/mesa_%.bbappend"
```

## conf/distro/ces-fb-rauc.conf
```bitbake
DISTRO = "ces-fb-rauc"
DISTRO_NAME = "CES FrameBuffer with RAUC update system"

require conf/distro/include/ces-base.inc

DISTROOVERRIDES = "ces:ces-fb-rauc"

DISTRO_FEATURES += "eglfs fbdev opengl virtualization rauc"

PACKAGECONFIG_append_pn-libsdl2 = " gles2 kmsdrm"

# Remove software rasterizer and add etnaviv and imx-drm libraries from mesa
GALLIUMDRIVERS_pn-mesa = "etnaviv,kmsro"

PACKAGECONFIG_append_pn-qtbase = " eglfs gbm kms"
PACKAGECONFIG_remove_pn-qtbase = " gl"
```

## conf/distro/ces-fb.conf
```bitbake
DISTRO = "ces-fb"
DISTRO_NAME = "CES FrameBuffer"

require conf/distro/include/ces-base.inc

DISTROOVERRIDES = "ces:ces-fb"

DISTRO_FEATURES += "eglfs fbdev opengl virtualization"

PACKAGECONFIG_append_pn-libsdl2 = " gles2 kmsdrm"

# Remove software rasterizer and add etnaviv and imx-drm libraries from mesa
GALLIUMDRIVERS_pn-mesa = "etnaviv,kmsro"

PACKAGECONFIG_append_pn-qtbase = " eglfs gbm kms"
PACKAGECONFIG_remove_pn-qtbase = " gl"
```

## conf/distro/ces-framebuffer.conf
```bitbake
# CES Distro for FrameBuffer graphical backend.

require conf/distro/include/ces-base.inc

DISTRO = "ces-framebuffer"
DISTRO_NAME = "CES FrameBuffer"

# Remove conflicting backends.
DISTRO_FEATURES_remove = "x11 wayland directfb "

# Remove features that are not necessary
DISTRO_FEATURES_remove = "pci 3g nfc zeroconf nfs alsa wifi bluetooth bluez5 irda pcmcia wayland x11 pulseaudio"
```

## conf/distro/ces-x11.conf
```bitbake
# CES Distro for X11 without wayland.

require conf/distro/include/ces-base.inc

DISTRO = "ces-x11"
DISTRO_NAME = "CES X11"

# Remove conflicting backends.
DISTRO_FEATURES_remove = "wayland directfb "

# These are X11 specific
DISTRO_FEATURES_append = " x11"

# Append pulseaudio for chromium
DISTRO_FEATURES_append = " pulseaudio"
```

## conf/distro/include/ces-base.inc
```bitbake
DISTRO ?= "ces-base"
DISTRO_NAME = "Christ Electronic Systems GmbH Distro Base"
DISTRO_VERSION = "3.1"
DISTRO_CODENAME = "dunfell"

MAINTAINER = "Christ Electronic Systems Embedded Linux Team <linux@christ-es.de>"

# Log information on images and packages
INHERIT += "buildhistory"
BUILDHISTORY_COMMIT = "1"

DISTROOVERRIDES = "ces"
INHERIT += "distrooverrides"

# Disable sysvinit for recipes with systemd support
DISTRO_FEATURES_BACKFILL_CONSIDERED += "sysvinit pulseaudio bluez5"
VIRTUAL-RUNTIME_init_manager = "systemd"
VIRTUAL-RUNTIME_initscripts = "systemd-compat-units"
VIRTUAL-RUNTIME_login_manager = "shadow-base"
VIRTUAL-RUNTIME_dev_manager = "udev"

# Default features (for packagegroup(-core)-base)
DISTRO_FEATURES_DEFAULT = "ipv6 pam systemd usbgadget usbhost vfat xattr ext2"
DISTRO_FEATURES += "${DISTRO_FEATURES_DEFAULT}"

# Disable python usage in opkg-utils
PACKAGECONFIG_remove_pn-opkg-utils = "python"

# Customize SDK variables according to the selected distro
SDK_NAME_PREFIX = "${DISTRO}"
SDK_VERSION ?= "${DISTRO_VERSION}"

TASK_BASIC_SSHDAEMON = "openssh-sshd openssh-sftp openssh-sftp-server"
```

## conf/layer.conf
```bitbake
# We have a conf and classes directory, add to BBPATH
BBPATH .= ":${LAYERDIR}"

# We have a packages directory, add to BBFILES
BBFILES += "${LAYERDIR}/recipes*/*/*.bb \
            ${LAYERDIR}/recipes*/*/*.bbappend"

BBFILE_COLLECTIONS += "ces-layer"
BBFILE_PATTERN_ces-layer := "^${LAYERDIR}/"
BBFILE_PRIORITY_ces-layer = "50"

# Let us add layer-specific bbappends which are only applied when that
# layer is included in our configuration
BBFILES += "${@' '.join('${LAYERDIR}/%s/recipes*/*/*.bbappend' % layer \
               for layer in BBFILE_COLLECTIONS.split())}"

LAYERSERIES_COMPAT_ces-layer = "dunfell"

LAYERDEPENDS_ces-layer = "openembedded-layer"
BB_DANGLINGAPPENDS_WARNONLY ?= "true"
```

## conf/local.conf.sample
```bitbake
# The reused default configuration from poky/meta-poky/conf/local.conf.sample
PACKAGE_CLASSES ?= "package_rpm"

# Uncomment the next line for development purposes
# but don't forget to remove debug-tweaks for production!
# EXTRA_IMAGE_FEATURES ?= "debug-tweaks"

USER_CLASSES ?= "buildstats image-mklibs image-prelink"
PATCHRESOLVE = "noop"
BB_DISKMON_DIRS ??= "\
    STOPTASKS,${TMPDIR},1G,100K \
    STOPTASKS,${DL_DIR},1G,100K \
    STOPTASKS,${SSTATE_DIR},1G,100K \
    STOPTASKS,/tmp,100M,100K \
    ABORT,${TMPDIR},100M,1K \
    ABORT,${DL_DIR},100M,1K \
    ABORT,${SSTATE_DIR},100M,1K \
    ABORT,/tmp,10M,1K"
PACKAGECONFIG_append_pn-qemu-system-native = " sdl"
PACKAGECONFIG_append_pn-nativesdk-qemu = " sdl"
CONF_VERSION = "1"

# Below are default CES build target and distro settings.

# The downloads directory is at the same level as build directory.
DL_DIR ?= "${TOPDIR}/../downloads"

# See the supported machine configurations under meta-ces/conf/machine/
MACHINE ??= "pixi-cdl100"

# See the supported distro configurations under meta-ces/conf/distro/
DISTRO ?= "ces-fb"
```

## conf/machine/4cbox-cdl200.conf
```bitbake
#@TYPE: Machine
#@NAME: Christ Electronic Systems 4CBOX-CDL200 based on Freescale i.MX6DL SABRE Smart Device
#@SOC: i.MX6DL
#@DESCRIPTION: Machine configuration for Christ Electronic Systems
#@MAINTAINER: Peter Fink <pfink@christ-es.de>

MACHINEOVERRIDES =. "mx6:mx6dl:"
MACHINEOVERRIDES =. "use-mainline-bsp:"
MACHINEOVERRIDES_EXTENDER_FILTER_OUT_append_use-mainline-bsp = " imxgpu imxgpu2d imxgpu3d"

include conf/machine/include/imx-base.inc
include conf/machine/include/tune-cortexa9.inc

MACHINE_FIRMWARE_FILTER_OUT_append_mx6q = " firmware-imx-vpu-imx6q"

KERNEL_DEVICETREE = "imx6dl-4cbox-cdlx00.dtb"

PREFERRED_PROVIDER_virtual/kernel = "linux-ces"
PREFERRED_PROVIDER_u-boot = "u-boot-fslc-ces"
PREFERRED_PROVIDER_virtual/bootloader = "u-boot-fslc-ces"
PREFERRED_PROVIDER_u-boot-fw-utils = "u-boot-fslc-ces-fw-utils"

UBOOT_MACHINE = "4cbox-cdl200_defconfig"

SERIAL_CONSOLE = "115200 ttymxc0 vt100"

MACHINE_FEATURES = "usbhost usbgadget vfat"

IMAGE_FSTYPES = "tar.bz2"
```

## conf/machine/blix-bdl100.conf
```bitbake
#@TYPE: Machine
#@NAME: Christ Electronic Systems BLIX based loosely on Freescale i.MX6DL SABRE Smart Device
#@SOC: i.MX6DL
#@DESCRIPTION: Machine configuration for Christ Electronic Systems
#@MAINTAINER: Peter Fink <pfink@christ-es.de>

MACHINEOVERRIDES =. "mx6:mx6dl:"

KERNEL_DEVICETREE = "imx6dl-blix-bdlx00.dtb"

UBOOT_CONFIG ??= "sd"
UBOOT_CONFIG[sd] = "blix-bdl100_defconfig,sdcard"
UBOOT_CONFIG[mfgtool] = "blix-bdl100_defconfig"
PREFERRED_PROVIDER_u-boot-fw-utils = "u-boot-fslc-fw-utils"

require conf/machine/include/imx-base.inc
require conf/machine/include/tune-cortexa9.inc

SERIAL_CONSOLE = "115200 ttymxc0"

IMAGE_FSTYPES = "tar.bz2"

# This machine is capable of sound output, so add alsa
DISTRO_FEATURES_append += "alsa"
```

## conf/machine/blix-bq100.conf
```bitbake
#@TYPE: Machine
#@NAME: Christ Electronic Systems BLIX based loosely on Freescale i.MX6DL SABRE Smart Device
#@SOC: i.MX6Q
#@DESCRIPTION: Machine configuration for Christ Electronic Systems
#@MAINTAINER: Peter Fink <pfink@christ-es.de>

MACHINEOVERRIDES =. "mx6:mx6q:"
MACHINEOVERRIDES =. "use-mainline-bsp:"
MACHINEOVERRIDES_EXTENDER_FILTER_OUT_append_use-mainline-bsp = " imxgpu imxgpu2d imxgpu3d"

include conf/machine/include/imx-base.inc
include conf/machine/include/tune-cortexa9.inc
include conf/machine/include/ces-imx-machine.conf

MACHINE_FIRMWARE_FILTER_OUT_append_mx6q = " firmware-imx-vpu-imx6q"

KERNEL_DEVICETREE = "imx6q-blix-bqx00.dtb"

PREFERRED_PROVIDER_virtual/kernel = "linux-ces"
PREFERRED_PROVIDER_u-boot = "u-boot-fslc-ces"
PREFERRED_PROVIDER_virtual/bootloader = "u-boot-fslc-ces"
PREFERRED_PROVIDER_u-boot-fw-utils = "u-boot-fslc-ces-fw-utils"

UBOOT_MACHINE = "blix-bq100_defconfig"

SERIAL_CONSOLE = "115200 ttymxc0 vt100"

MACHINE_FEATURES = "usbhost usbgadget vfat"

IMAGE_FSTYPES = "tar.bz2"

# This machine is capable of sound output, so add alsa
DISTRO_FEATURES_append += "alsa"
```

## conf/machine/crix-arq100.conf
```bitbake
#@TYPE: Machine
#@NAME: Christ Electronic Systems CRIX-ARQ100 based on Freescale i.MX6Q SABRE Smart Device
#@SOC: i.MX6Q
#@DESCRIPTION: Machine configuration for Christ Electronic Systems
#@MAINTAINER: Peter Fink <pfink@christ-es.de>

MACHINEOVERRIDES =. "mx6:mx6q:"

KERNEL_DEVICETREE = "imx6q-crix-arqx00.dtb"

UBOOT_CONFIG ??= "sd"
UBOOT_CONFIG[sd] = "crix-arq100_defconfig,sdcard"
UBOOT_CONFIG[mfgtool] = "crix-arq100_defconfig"
PREFERRED_PROVIDER_u-boot-fw-utils = "u-boot-fslc-fw-utils"

require conf/machine/include/imx-base.inc
require conf/machine/include/tune-cortexa9.inc

SERIAL_CONSOLE = "115200 ttymxc0"

IMAGE_FSTYPES = "tar.bz2"

# This machine is capable of sound output, so add alsa and pulseaudio
MACHINE_FEATURES += "pulseaudio alsa"
```

## conf/machine/crix-cdl100.conf
```bitbake
#@TYPE: Machine
#@NAME: Christ Electronic Systems CRIX-CDL100 based on Freescale i.MX6Q SABRE Smart Device
#@SOC: i.MX6DL
#@DESCRIPTION: Machine configuration for Christ Electronic Systems
#@MAINTAINER: Peter Fink <pfink@christ-es.de>

MACHINEOVERRIDES =. "mx6:mx6dl:"

KERNEL_DEVICETREE = "imx6dl-crix-cdlx00.dtb"

UBOOT_CONFIG ??= "sd"
UBOOT_CONFIG[sd] = "crix-cdl100_defconfig,sdcard"
UBOOT_CONFIG[mfgtool] = "crix-cdl100_defconfig"
PREFERRED_PROVIDER_u-boot-fw-utils = "u-boot-fslc-fw-utils"

require conf/machine/include/imx-base.inc
require conf/machine/include/tune-cortexa9.inc

SERIAL_CONSOLE = "115200 ttymxc0"

IMAGE_FSTYPES = "tar.bz2"
```

## conf/machine/crix-cq100.conf
```bitbake
#@TYPE: Machine
#@NAME: Christ Electronic Systems CRIX-CQ100 based on Freescale i.MX6Q SABRE Smart Device
#@SOC: i.MX6Q
#@DESCRIPTION: Machine configuration for Christ Electronic Systems
#@MAINTAINER: Peter Fink <pfink@christ-es.de>

MACHINEOVERRIDES = "mx6:mx6q"

KERNEL_DEVICETREE = "imx6q-crix-cq100.dtb"

UBOOT_CONFIG ??= "sd"
UBOOT_CONFIG[sd] = "crix-cq100_defconfig,sdcard"
UBOOT_CONFIG[mfgtool] = "crix-cq100_defconfig"

require conf/machine/include/imx-base.inc
require conf/machine/include/tune-cortexa9.inc

SERIAL_CONSOLE = "115200 ttymxc0"

IMAGE_FSTYPES = "tar.bz2"
```

## conf/machine/crixq.conf
```bitbake
#@TYPE: Machine
#@NAME: Christ Electronic Systems CRIXQ based on Freescale i.MX6Q SABRE Smart Device
#@SOC: i.MX6Q
#@DESCRIPTION: Machine configuration for Christ Electronic Systems
#@MAINTAINER: Peter Fink <pfink@christ-es.de>

MACHINEOVERRIDES = "mx6:mx6q"

KERNEL_DEVICETREE = "imx6q-crix.dtb"

UBOOT_CONFIG ??= "sd"
UBOOT_CONFIG[sd] = "crix6q_defconfig,sdcard"
UBOOT_CONFIG[mfgtool] = "crix6q_defconfig"

require conf/machine/include/imx-base.inc
require conf/machine/include/tune-cortexa9.inc

SERIAL_CONSOLE = "115200 ttymxc0"

IMAGE_FSTYPES = "tar.bz2"

# We want images supporting the following features (for packagegroup(-core)-base)
DISTRO_FEATURES_DEFAULT += "argp ext2 largefile usbgadget usbhost xattr ipv4 ipv6 systemd vfat"
DISTRO_FEATURES_remove += "pci 3g nfc zeroconf nfs alsa pulseaudio wifi bluetooth bluez5 irda pcmcia x11 wayland"

# Disable sysvinit for recipes with systemd support
DISTRO_FEATURES_BACKFILL_CONSIDERED += "sysvinit"
VIRTUAL-RUNTIME_init_manager = "systemd"
# Uncomment to completely disable support for sysv scripts:
#PACKAGECONFIG_pn-systemd = "xz"
```

## conf/machine/include/ces-imx-machine.conf
```bitbake
#@TYPE: Machine
#@NAME: Christ Electronic Systems machines based generic configuration
#@DESCRIPTION: Base machine configuration for Christ Electronic Systems
#@MAINTAINER: Steffen Kothe <skothe@christ-es.de>

MACHINEOVERRIDES =. "ces-imx:"
```

## conf/machine/pixi-cdl100.conf
```bitbake
#@TYPE: Machine
#@NAME: Christ Electronic Systems PIXI based loosely on Freescale i.MX6DL SABRE Smart Device
#@SOC: i.MX6DL
#@DESCRIPTION: Machine configuration for Christ Electronic Systems
#@MAINTAINER: Peter Fink <pfink@christ-es.de>

MACHINEOVERRIDES =. "mx6:mx6dl:"
MACHINEOVERRIDES =. "use-mainline-bsp:"
MACHINEOVERRIDES_EXTENDER_FILTER_OUT_append_use-mainline-bsp = " imxgpu imxgpu2d imxgpu3d"

include conf/machine/include/imx-base.inc
include conf/machine/include/tune-cortexa9.inc

KERNEL_DEVICETREE = "imx6dl-pixi-cdlx00.dtb"

PREFERRED_PROVIDER_virtual/kernel = "linux-ces"
PREFERRED_PROVIDER_virtual/bootloader = "u-boot-fslc"

UBOOT_MACHINE = "pixi-cdl100_defconfig"

SERIAL_CONSOLE = "115200 ttymxc0 vt100"

MACHINE_FEATURES = "usbhost usbgadget vfat"

IMAGE_FSTYPES = "tar.bz2"
```

## conf/machine/pixi-cdl200.conf
```bitbake
#@TYPE: Machine
#@NAME: Christ Electronic Systems PIXI based loosely on Freescale i.MX6DL SABRE Smart Device
#@SOC: i.MX6DL
#@DESCRIPTION: Machine configuration for Christ Electronic Systems
#@MAINTAINER: Peter Fink <pfink@christ-es.de>

MACHINEOVERRIDES =. "mx6:mx6dl:"

KERNEL_DEVICETREE = "imx6dl-pixi-cdl200.dtb"

UBOOT_CONFIG ??= "sd"
UBOOT_CONFIG[sd] = "pixi-cdl200_defconfig,sdcard"
UBOOT_CONFIG[mfgtool] = "pixi-cdl200_defconfig"

require conf/machine/include/imx-base.inc
require conf/machine/include/tune-cortexa9.inc

SERIAL_CONSOLE = "115200 ttymxc0"

IMAGE_FSTYPES = "tar.bz2"

# We want images supporting the following features (for packagegroup(-core)-base)
DISTRO_FEATURES_DEFAULT += "argp ext2 largefile usbgadget usbhost xattr ipv4 ipv6 systemd vfat"
DISTRO_FEATURES_remove += "pci 3g nfc zeroconf nfs alsa wifi bluetooth bluez5 irda pcmcia wayland x11 pulseaudio"

# Disable sysvinit for recipes with systemd support
DISTRO_FEATURES_BACKFILL_CONSIDERED += "sysvinit"
VIRTUAL-RUNTIME_init_manager = "systemd"
# Uncomment to completely disable support for sysv scripts:
#PACKAGECONFIG_pn-systemd = "xz"
```

## conf/machine/pixi-cq200.conf
```bitbake
#@TYPE: Machine
#@NAME: Christ Electronic Systems PIXI based loosely on Freescale i.MX6DL SABRE Smart Device
#@SOC: i.MX6DL
#@DESCRIPTION: Machine configuration for Christ Electronic Systems
#@MAINTAINER: Peter Fink <pfink@christ-es.de>

MACHINEOVERRIDES =. "mx6:mx6q:"

KERNEL_DEVICETREE = "imx6q-pixi-cq200.dtb"

UBOOT_CONFIG ??= "sd"
UBOOT_CONFIG[sd] = "pixi-cq200_defconfig,sdcard"
UBOOT_CONFIG[mfgtool] = "pixi-cq200_defconfig"

require conf/machine/include/imx-base.inc
require conf/machine/include/tune-cortexa9.inc

SERIAL_CONSOLE = "115200 ttymxc0"

IMAGE_FSTYPES = "tar.bz2"
```
